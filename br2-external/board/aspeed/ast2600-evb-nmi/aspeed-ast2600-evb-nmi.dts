#include "aspeed-ast2600-evb.dts"
#include <dt-bindings/i2c/i2c.h>

&i2c15 {
	multi-master;
	mctp-controller;

	mctp@10 {
		compatible = "mctp-i2c-controller";
		reg = <(0x10 | I2C_OWN_SLAVE_ADDRESS)>;
	};
};
