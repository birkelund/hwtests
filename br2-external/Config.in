## br2-external/configs/aspeed_ast2600evb_nmi_defconfig
```kconfig
# Architecture
BR2_arm=y
BR2_cortex_a7=y
BR2_ARM_FPU_VFPV4=y

# System
BR2_TARGET_GENERIC_HOSTNAME="nmi-i2c"
BR2_TARGET_GENERIC_ISSUE="Aspeed AST2600 EVB (+nmi-i2c)"
BR2_SYSTEM_DHCP="eth0"

# Filesystem
BR2_TARGET_ROOTFS_CPIO=y
BR2_TARGET_ROOTFS_CPIO_XZ=y

# Linux headers same as kernel
BR2_PACKAGE_HOST_LINUX_HEADERS_CUSTOM_6_1=y

# Kernel
BR2_LINUX_KERNEL=y
BR2_LINUX_KERNEL_CUSTOM_VERSION=y
BR2_LINUX_KERNEL_CUSTOM_VERSION_VALUE="6.2"
BR2_LINUX_KERNEL_DEFCONFIG="aspeed_g5"
BR2_LINUX_KERNEL_CONFIG_FRAGMENT_FILES="$(BR2_EXTERNAL_NMI_I2C_PATH)/board/aspeed/ast2600-evb-nmi/linux.fragment"
BR2_LINUX_KERNEL_DTS_SUPPORT=y
BR2_LINUX_KERNEL_CUSTOM_DTS_PATH="$(BR2_EXTERNAL_NMI_I2C_PATH)/board/aspeed/ast2600-evb-nmi/aspeed-ast2600-evb-nmi.dts"

# Target tools
BR2_PACKAGE_MCTP=y
BR2_PACKAGE_LIBNVME=y
BR2_PACKAGE_DROPBEAR=y
BR2_PACKAGE_DROPBEAR_DISABLE_REVERSEDNS=y
```

## br2-external/configs/qemu_mips32r6_malta_defconfig
```kconfig
BR2_mips=y
BR2_mips_32r6=y
BR2_PACKAGE_HOST_LINUX_HEADERS_CUSTOM_6_1=y
BR2_TARGET_GENERIC_GETTY_PORT="ttyS0"
BR2_ROOTFS_POST_IMAGE_SCRIPT="board/qemu/post-image.sh"
BR2_ROOTFS_POST_SCRIPT_ARGS="$(BR2_DEFCONFIG)"
BR2_LINUX_KERNEL=y
BR2_LINUX_KERNEL_CUSTOM_VERSION=y
BR2_LINUX_KERNEL_CUSTOM_VERSION_VALUE="6.1.26"
BR2_LINUX_KERNEL_USE_CUSTOM_CONFIG=y
BR2_LINUX_KERNEL_CUSTOM_CONFIG_FILE="board/qemu/mips32r6-malta/linux.config"
BR2_LINUX_KERNEL_CONFIG_FRAGMENT_FILES="$(BR2_EXTERNAL_QEMU_HW_NVME_PATH)/board/qemu/nvme/linux.fragment"
BR2_LINUX_KERNEL_VMLINUX=y
BR2_TARGET_ROOTFS_EXT2=y
# BR2_TARGET_ROOTFS_TAR is not set
```

## br2-external/configs/qemu_ppc64le_pseries_defconfig
```kconfig
BR2_powerpc64le=y
BR2_PACKAGE_HOST_LINUX_HEADERS_CUSTOM_6_1=y
BR2_TARGET_GENERIC_GETTY_PORT="hvc0"
BR2_ROOTFS_POST_IMAGE_SCRIPT="board/qemu/post-image.sh"
BR2_ROOTFS_POST_SCRIPT_ARGS="$(BR2_DEFCONFIG)"
BR2_LINUX_KERNEL=y
BR2_LINUX_KERNEL_CUSTOM_VERSION=y
BR2_LINUX_KERNEL_CUSTOM_VERSION_VALUE="6.1.26"
BR2_LINUX_KERNEL_DEFCONFIG="pseries_le"
BR2_LINUX_KERNEL_CONFIG_FRAGMENT_FILES="$(BR2_EXTERNAL_QEMU_HW_NVME_PATH)/board/qemu/nvme/linux.fragment"
BR2_LINUX_KERNEL_VMLINUX=y
BR2_TARGET_ROOTFS_EXT2=y
# BR2_TARGET_ROOTFS_TAR is not set
BR2_PACKAGE_HOST_QEMU=y
BR2_PACKAGE_HOST_QEMU_SYSTEM_MODE=y
```

## br2-external/configs/qemu_s390x_defconfig
```kconfig
BR2_s390x=y
BR2_ROOTFS_DEVICE_CREATION_DYNAMIC_EUDEV=y
BR2_ROOTFS_POST_IMAGE_SCRIPT="board/qemu/post-image.sh"
BR2_ROOTFS_POST_SCRIPT_ARGS="$(BR2_DEFCONFIG)"
BR2_LINUX_KERNEL=y
BR2_LINUX_KERNEL_USE_ARCH_DEFAULT_CONFIG=y
BR2_LINUX_KERNEL_CONFIG_FRAGMENT_FILES="$(BR2_EXTERNAL_HWTESTS_PATH)/board/qemu/nvme/linux.fragment"
BR2_LINUX_KERNEL_NEEDS_HOST_OPENSSL=y
BR2_TARGET_ROOTFS_EXT2=y
BR2_TARGET_ROOTFS_EXT2_SIZE="128M"
# BR2_TARGET_ROOTFS_TAR is not set
```

## br2-external/configs/qemu_sparc64_sun4u_defconfig
```kconfig
BR2_sparc64=y
BR2_ROOTFS_POST_IMAGE_SCRIPT="board/qemu/post-image.sh"
BR2_ROOTFS_POST_SCRIPT_ARGS="$(BR2_DEFCONFIG)"
BR2_LINUX_KERNEL=y
BR2_LINUX_KERNEL_USE_CUSTOM_CONFIG=y
BR2_LINUX_KERNEL_CUSTOM_CONFIG_FILE="board/qemu/sparc64-sun4u/linux.config"
BR2_LINUX_KERNEL_CONFIG_FRAGMENT_FILES="$(BR2_EXTERNAL_HWTESTS_PATH)/board/qemu/nvme/linux.fragment"
BR2_TARGET_ROOTFS_EXT2=y
# BR2_TARGET_ROOTFS_TAR is not set
```

## br2-external/package/libnvme/Config.in
```kconfig
config BR2_PACKAGE_LIBNVME
	bool "libnvme"
	select BR2_PACKAGE_UTIL_LINUX
	select BR2_PACKAGE_UTIL_LINUX_LIBUUID
	select BR2_PACKAGE_JSON_C
	help
	  This is the libnvme development C library. libnvme provides type
	  definitions for NVMe specification structures, enumerations, and bit
	  fields, helper functions to construct, dispatch, and decode commands
	  and payloads, and utilities to connect, scan, and manage nvme devices
	  on a Linux system.
```

## br2-external/package/mctp/Config.in
```kconfig
config BR2_PACKAGE_MCTP
	bool "mctp"
	help
	  This project contains two utilities for running a MCTP network from
	  the local machine:
	  
	    * mctp: A small command-line utility to query and manage the state
	      of the kernel MCTP stack, in a similar way to iproute2's ip utility.
	  
	    * mctpd: A daemon implementing the MCTP control protocol; you'll
	      need this for the local host to perform as a bus-owner. The main
	      function of mctpd is to assign EIDs to remote endpoints, and
	      manage the resulting routes and neighbour-table entries for those
	      endpoints.
```
